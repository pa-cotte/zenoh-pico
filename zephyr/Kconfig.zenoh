## zephyr/Kconfig.zenoh
```kconfig
config ZENOH_PICO
	bool "Zenoh PICO library"
	help
	  Enable Zenoh pico support

if ZENOH_PICO

config ZENOH_PICO_LINK_SERIAL
	bool "Serial Link"
	help
	  Use serial link

config ZENOH_PICO_MULTI_THREAD
	bool "Multithreading support"
	default y
	help
	  Multithreading support

config ZENOH_PICO_PUBLICATION
	bool "Publication Support"
	default y
	help
	  Publication support

config ZENOH_PICO_SUBSCRIPTION
	bool "Subscription Support"
	default y
	help
	  Subscription Support

config ZENOH_PICO_QUERY
	bool "Query Support"
	default y
	help
	  Query Support

config ZENOH_PICO_QUERYABLE
	bool "Queryable Support"
	default y
	help
	  Queryable Support

config ZENOH_PICO_RAWETH_TRANSPORT
	bool "Raw Ethernet Support"
	help
	  Raw Ethernet Support

config ZENOH_PICO_LINK_TCP
	bool "TCP Link"
	help
	  TCP Link

config ZENOH_PICO_LINK_UDP_UNICAST
	bool "UDP Unicast"
	help
	  UDP Unicast

config ZENOH_PICO_LINK_UDP_MULTICAST
	bool "UDP Multicast"
	default y
	help
	  UDP Multicast

config ZENOH_PICO_SCOUTING
	bool "Scouting UDP"
	default y
	help
	  Scouting UDP

config ZENOH_PICO_LINK_WS
	bool "WS Link"
	help
	  WS Link

config ZENOH_PICO_MULTICAST_TRANSPORT
	bool "Multicast Transport"
	default y
	help
	  Multicast Transport Support

config ZENOH_PICO_LOCAL_SUBSCRIBER
	bool "Local Subscriber"
	default y
	help
	  Enable local subscriber (same-session pub/sub)

config ZENOH_PICO_LOCAL_QUERYABLE
	bool "Local Queryable"
	default y
	help
	  Enable local queryable (same-session query/queryable)

config ZENOH_PICO_INTEREST
	bool "Interest Support"
	default y
	help
	  Interest Support for advanced pub/sub features

config ZENOH_PICO_ADVANCED_PUBLICATION
	bool "Advanced Publication"
	default y
	help
	  Advanced Publication Support

config ZENOH_PICO_ADVANCED_SUBSCRIPTION
	bool "Advanced Subscription"
	default y
	help
	  Advanced Subscription Support

endif
```
